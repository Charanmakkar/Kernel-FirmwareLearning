/dts-v1/;
/plugin/;
/ {
 compatible = "brcm,bcm2711";
 fragment@0 {
  target = <&i2c1>;
  __overlay__ {
   status = "okay";
   #address-cells = <1>;
   #size-cells = <0>;
   temperature@48 {
    compatible = "learning,tmp102";
    reg = <0x48>;
   };
  };
 };
};
