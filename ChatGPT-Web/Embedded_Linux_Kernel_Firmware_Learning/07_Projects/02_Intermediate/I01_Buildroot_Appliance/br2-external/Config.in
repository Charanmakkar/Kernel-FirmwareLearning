## ChatGPT-Web/Embedded_Linux_Kernel_Firmware_Learning/07_Projects/02_Intermediate/I01_Buildroot_Appliance/br2-external/package/learn-telemetry/Config.in
```kconfig
config BR2_PACKAGE_LEARN_TELEMETRY
	bool "learn-telemetry"
	help
	  Small persistent counter appliance used for learning packaging and recovery.
```

## ChatGPT-Web/Embedded_Linux_Kernel_Firmware_Learning/07_Projects/02_Intermediate/I04_Yocto_Telemetry/meta-learning/conf/layer.conf
```bitbake
BBPATH .= ":${LAYERDIR}"
BBFILES += "${LAYERDIR}/recipes-*/*/*.bb ${LAYERDIR}/recipes-*/*/*.bbappend"
BBFILE_COLLECTIONS += "learning"
BBFILE_PATTERN_learning = "^${LAYERDIR}/"
BBFILE_PRIORITY_learning = "6"
LAYERSERIES_COMPAT_learning = "scarthgap"
LAYERDEPENDS_learning = "core"
```

## ChatGPT-Web/Embedded_Linux_Kernel_Firmware_Learning/07_Projects/04_Capstone/C01_Industrial_Gateway/config/meta-gateway/conf/layer.conf
```bitbake
BBPATH .= ":${LAYERDIR}"
BBFILES += "${LAYERDIR}/recipes-*/*/*.bb"
BBFILE_COLLECTIONS += "gateway"
BBFILE_PATTERN_gateway = "^${LAYERDIR}/"
BBFILE_PRIORITY_gateway = "7"
LAYERSERIES_COMPAT_gateway = "scarthgap"
LAYERDEPENDS_gateway = "core"
```
