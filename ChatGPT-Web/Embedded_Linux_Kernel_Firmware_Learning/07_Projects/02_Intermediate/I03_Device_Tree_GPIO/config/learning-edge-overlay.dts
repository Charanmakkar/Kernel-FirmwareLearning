/dts-v1/;
/plugin/;
/ {
 compatible = "brcm,bcm2711";
 fragment@0 {
  target-path = "/";
  __overlay__ {
   learning_edge {
    compatible = "learning,gpio-edge-counter";
    event-gpios = <&gpio 17 0>;
    status = "okay";
   };
  };
 };
};
